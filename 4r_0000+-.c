#include <avr/io.h>
#include <util/delay.h>
#include <avr/interrupt.h>
#define F_CPU 1000000UL
#define T 300

unsigned char z = 1;
unsigned int ind = 0;

unsigned int chisla [10] = {
	0b00111111, //0
	0b00000110, //1
	0b01011011, //2
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	0b01101111, //9
};

unsigned int razr1 = 0, razr2 = 0, razr3 = 0, razr4 = 0;

void vse_na_indikatore (unsigned int razbivka_chisla) {
	razr1 = razbivka_chisla/1000; 
	// переменная для первого разряда индикатора
	razr2 = razbivka_chisla%1000/100; 
	// переменная для второго разряда индикатора
	razr3 = razbivka_chisla%100/10; 
	// переменная для третьего разряда индикатора
	razr4 = razbivka_chisla%10; 
	// переменная для четвертого разряда индикатора
}

ISR (TIMER0_OVF_vect) {
	if (z == 1) {PORTB = 0b00000001; PORTD = chisla[razr1];}
	if (z == 2) {PORTB = 0b00000010; PORTD = chisla[razr2];}
	if (z == 3) {PORTB = 0b00000100; PORTD = chisla[razr3];}
	if (z == 4) {PORTB = 0b00001000; PORTD = chisla[razr4];}
	z++;
	
	if (z > 4) {z=1;}
};

int main(void)
{
	DDRD = 0b11111111;  
	// PORDD - отвечает за то, что написано в одном разряде
	PORTD = 0b00000000;

	DDRB = 0b00001111; // PORDB - отвечает за разряд
	PORTB = 0b00000000; 
	// при подаче напряжения не будут сразу гореть индикаторы
	
	DDRC &= ~((1<<4) | (1<<5));
	// настроим 4 и 5 выход порта С на вход (нолики), 
	чтобы подключить туда кнопочки
	PORTC |= ((1<<4) | (1<<5)); 
	// установили подтягивающие резисторы (единички) на 4 и 5 выходы порта С
	
	TCCR0 |= (1<<2); TCCR0 &= ~((1<<0) | (1<<1)); 
	//  Настройка таймера с предделителем на f/256
	TCNT0 = 0; // обнуление таймер-счётчика 
	TIMSK |= (1<<0); // Разрешить прерывание по переполнению таймера
	sei(); // разрешить глобальные прерывания
	
	while (1)
	{
		vse_na_indikatore(ind); 
		// изначально на индикаторе будут все нули 0000
		
		if (~PINC & (1<<5)) { 
		// при нажатии на кнопку, подключенную к порту PC5, 
			ind++;            
		// число на индикаторе будет увеличиваться
			_delay_ms(T);
		}
		if (~PINC & (1<<4)) { 
		// при нажатии на кнопку, подключенную к порту PC4,
			ind--;            
		// число на индикаторе будет уменьшаться
			_delay_ms(T);
		}
	}
}